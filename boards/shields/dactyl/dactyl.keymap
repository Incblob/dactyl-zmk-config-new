#include <behaviors.dtsi>
#include <dt-bindings/zmk/bt.h>
#include <dt-bindings/zmk/keys.h>
#include <dt-bindings/zmk/outputs.h>

#define l_ALPHA 0
#define l_CODE 1
#define l_HD 2
#define l_HD_CODE 3
#define l_L  4
#define l_R  5
#define l_B  6
#define l_FUNC 7


#include "../globals.dtsi"
// &mt {
//     tapping-term-ms = <145>;
//     quick_tap_ms = <140>;
// };

// &sk {
//     release-after-ms = <2000>;
//     quick-release;
//     lazy;
// };

// &lt {
//     tapping-term-ms = <140>;
// };

// &caps_word {
//         continue-list = <UNDERSCORE MINUS BACKSPACE DELETE LEFT RIGHT LS(FSLH) FSLH>;
//     };


/{
    conditional_layers {
        compatible = "zmk,conditional-layers";
        tri_layer {
            if-layers = <l_L l_R>;
            then-layer = <l_B>;
        };
    };
    // #include "../globals.dtsi"
    #define AS(keycode) &as LS(keycode) keycode     // Autoshift Macro

    #include "dactyl_layout.dtsi"
    #include "../combos.dtsi"
    #include "../macros.dtsi"
    #include "../behaviors.dtsi"


    keymap {
        compatible = "zmk,keymap";
        #include "dactyl_layers.dtsi"
    };
};
